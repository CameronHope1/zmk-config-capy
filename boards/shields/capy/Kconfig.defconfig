## boards/shields/capy/Kconfig.defconfig
```kconfig
if SHIELD_CAPY_LEFT

config ZMK_KEYBOARD_NAME
    default "capy"

config ZMK_SPLIT_ROLE_CENTRAL
    default y

endif

if SHIELD_CAPY_LEFT || SHIELD_CAPY_RIGHT

config ZMK_SPLIT
    default y
endif
```

## boards/shields/capy/Kconfig.shield
```kconfig
config SHIELD_CAPY_LEFT
    def_bool $(shields_list_contains,capy_left)

config SHIELD_CAPY_RIGHT
    def_bool $(shields_list_contains,capy_right)
```

## config/boards/shields/capy/Kconfig.defconfig
```kconfig
if SHIELD_CAPY_LEFT || SHIELD_CAPY_RIGHT

config ZMK_KEYBOARD_NAME
    default "Capy"

config ZMK_SPLIT
    default y

if SHIELD_CAPY_LEFT
config ZMK_SPLIT_ROLE_CENTRAL
    default y
endif

endif
```

## config/boards/shields/capy/Kconfig.shield
```kconfig
config SHIELD_CAPY_LEFT
    def_bool $(shields_list_contains, Capy_left)

config SHIELD_CAPY_RIGHT
    def_bool $(shields_list_contains, Capy_right)
```
